## GuideOS/Config.in
```kconfig
source "$BR2_EXTERNAL_GUIDE_OS_PATH/package/guide-hello-fb/Config.in"
source "$BR2_EXTERNAL_GUIDE_OS_PATH/package/guide-wikipedia-core/Config.in"
source "$BR2_EXTERNAL_GUIDE_OS_PATH/package/guide-node-link-core/Config.in"
source "$BR2_EXTERNAL_GUIDE_OS_PATH/package/guide-diagnostics/Config.in"
```

## GuideOS/configs/guideos_rg35xxh_ddr4_defconfig
```kconfig
BR2_aarch64=y
BR2_ARM_FPU_VFPV4=y
BR2_PACKAGE_HOST_LINUX_HEADERS_CUSTOM_6_12=y
BR2_GLOBAL_PATCH_DIR="$(BR2_EXTERNAL_GUIDE_OS_PATH)/board/rg35xxh/patches"
BR2_TARGET_GENERIC_HOSTNAME="guide-deck"
BR2_TARGET_GENERIC_ISSUE="GuideOS BRINGUP-0"
BR2_ROOTFS_DEVICE_CREATION_DYNAMIC_MDEV=y
BR2_ROOTFS_OVERLAY="$(BR2_EXTERNAL_GUIDE_OS_PATH)/board/common/rootfs-overlay"
BR2_ROOTFS_POST_BUILD_SCRIPT="$(BR2_EXTERNAL_GUIDE_OS_PATH)/board/rg35xxh/post-build.sh"
BR2_ROOTFS_POST_IMAGE_SCRIPT="support/scripts/genimage.sh"
BR2_ROOTFS_POST_SCRIPT_ARGS="-c $(BR2_EXTERNAL_GUIDE_OS_PATH)/board/rg35xxh/genimage.cfg"
BR2_LINUX_KERNEL=y
BR2_LINUX_KERNEL_CUSTOM_VERSION=y
BR2_LINUX_KERNEL_CUSTOM_VERSION_VALUE="7.1.2"
BR2_LINUX_KERNEL_USE_ARCH_DEFAULT_CONFIG=y
BR2_LINUX_KERNEL_CONFIG_FRAGMENT_FILES="$(BR2_EXTERNAL_GUIDE_OS_PATH)/board/rg35xxh/kernel.fragment"
BR2_LINUX_KERNEL_DTS_SUPPORT=y
BR2_LINUX_KERNEL_INTREE_DTS_NAME="allwinner/sun50i-h700-anbernic-rg35xx-h"
BR2_LINUX_KERNEL_CUSTOM_DTS_DIR="$(BR2_EXTERNAL_GUIDE_OS_PATH)/board/rg35xxh/dts"
BR2_LINUX_KERNEL_DTB_KEEP_DIRNAME=y
BR2_LINUX_KERNEL_NEEDS_HOST_OPENSSL=y
BR2_TARGET_ROOTFS_EXT2=y
BR2_TARGET_ROOTFS_EXT2_4=y
BR2_TARGET_ROOTFS_EXT2_SIZE="256M"
# BR2_TARGET_ROOTFS_TAR is not set
BR2_TARGET_ARM_TRUSTED_FIRMWARE=y
BR2_TARGET_ARM_TRUSTED_FIRMWARE_CUSTOM_VERSION=y
BR2_TARGET_ARM_TRUSTED_FIRMWARE_CUSTOM_VERSION_VALUE="v2.12.0"
BR2_TARGET_ARM_TRUSTED_FIRMWARE_PLATFORM="sun50i_h616"
BR2_TARGET_UBOOT=y
BR2_TARGET_UBOOT_BUILD_SYSTEM_KCONFIG=y
BR2_TARGET_UBOOT_CUSTOM_VERSION=y
BR2_TARGET_UBOOT_CUSTOM_VERSION_VALUE="2026.01"
BR2_TARGET_UBOOT_USE_CUSTOM_CONFIG=y
BR2_TARGET_UBOOT_CUSTOM_CONFIG_FILE="$(BR2_EXTERNAL_GUIDE_OS_PATH)/board/rg35xxh/uboot/anbernic_rg35xx_h700_lpddr4_defconfig"
BR2_TARGET_UBOOT_NEEDS_DTC=y
BR2_TARGET_UBOOT_NEEDS_PYLIBFDT=y
BR2_TARGET_UBOOT_NEEDS_OPENSSL=y
BR2_TARGET_UBOOT_NEEDS_GNUTLS=y
BR2_TARGET_UBOOT_NEEDS_ATF_BL31=y
BR2_TARGET_UBOOT_SPL=y
BR2_TARGET_UBOOT_SPL_NAME="u-boot-sunxi-with-spl.bin"
BR2_TARGET_UBOOT_CUSTOM_MAKEOPTS="SCP=/dev/null"
BR2_PACKAGE_LINUX_FIRMWARE=y
BR2_PACKAGE_LINUX_FIRMWARE_RTL_RTW88=y
BR2_PACKAGE_LINUX_FIRMWARE_RTL_88XX_BT=y
BR2_PACKAGE_IW=y
BR2_PACKAGE_WPA_SUPPLICANT=y
BR2_PACKAGE_WPA_SUPPLICANT_NL80211=y
BR2_PACKAGE_EVTEST=y
BR2_PACKAGE_HOST_DOSFSTOOLS=y
BR2_PACKAGE_HOST_GENIMAGE=y
BR2_PACKAGE_HOST_MTOOLS=y
BR2_PACKAGE_HOST_UBOOT_TOOLS=y
```

## GuideOS/package/guide-diagnostics/Config.in
```kconfig
config BR2_PACKAGE_GUIDE_DIAGNOSTICS
	bool "guide-diagnostics"
	select BR2_PACKAGE_PYTHON3
	help
	  Bounded, secret-free hardware and service reports for an authorized
	  GuideOS Developer Link session.
```

## GuideOS/package/guide-hello-fb/Config.in
```kconfig
config BR2_PACKAGE_GUIDE_HELLO_FB
	bool "guide-hello-fb"
	help
	  Minimal framebuffer proof for the private RG35XX H compatibility
	  bridge. It draws DON'T PANIC without a window system or console.
```

## GuideOS/package/guide-node-link-core/Config.in
```kconfig
config BR2_PACKAGE_GUIDE_NODE_LINK_CORE
	bool "guide-node-link-core"
	select BR2_PACKAGE_PYTHON3
	select BR2_PACKAGE_ALSA_LIB
	help
	  Bounded local discovery, pairing, media, and speaker-path support for
	  Guide Desktop Nodes and the RG35XX H Deck prototype.
```

## GuideOS/package/guide-se-deck/Config.in
```kconfig
config BR2_PACKAGE_GUIDE_SE_DECK
	bool "guide-se-deck"
	depends on BR2_PACKAGE_PYTHON3
	help
	  Install the bounded Deck-side interface for a Node-hosted Semiotic Engine.
```

## GuideOS/package/guide-supervisor/Config.in
```kconfig
config BR2_PACKAGE_GUIDE_SUPERVISOR
	bool "guide-supervisor"
	help
	  Minimal GuideOS PID 1 and foreground-session supervisor. It owns
	  process lifecycle, orphan reaping, scheduling classes, recovery,
	  and safe shutdown while the Guide interface runs as a child.
```

## GuideOS/package/guide-wikipedia-core/Config.in
```kconfig
config BR2_PACKAGE_GUIDE_WIKIPEDIA_CORE
	bool "guide-wikipedia-core"
	depends on BR2_PACKAGE_PYTHON3
	depends on !BR2_STATIC_LIBS
	select BR2_PACKAGE_PYTHON3_SSL
	select BR2_PACKAGE_CA_CERTIFICATES
	select BR2_PACKAGE_NETSURF
	select BR2_PACKAGE_NETSURF_SDL
	select BR2_PACKAGE_LIBCURL
	select BR2_PACKAGE_FREETYPE
	select BR2_PACKAGE_WEBP
	help
	  Guide Wikipedia data, offline-storage, and constrained NetSurf view.
	  Wikipedia HTML is reduced to a passive allow-list before rendering;
	  remote scripts and arbitrary web navigation are not enabled.
```
