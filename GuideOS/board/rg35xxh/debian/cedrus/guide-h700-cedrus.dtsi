// SPDX-License-Identifier: (GPL-2.0-only OR BSD-2-Clause)
// H700 resources from GreenOvercast's tested ROCKNIX overlay, with symbolic IDs.
#include <dt-bindings/clock/sun50i-h616-ccu.h>
#include <dt-bindings/reset/sun50i-h616-ccu.h>
#include <dt-bindings/interrupt-controller/arm-gic.h>

/ {
    soc {
        guide_ve: video-codec@1c0e000 {
            compatible = "allwinner,sun50i-h616-video-engine";
            reg = <0x01c0e000 0x2000>;
            clocks = <&ccu CLK_BUS_VE>, <&ccu CLK_VE>, <&ccu CLK_MBUS_VE>;
            clock-names = "ahb", "mod", "ram";
            resets = <&ccu RST_BUS_VE>;
            interrupt-parent = <&gic>;
            interrupts = <GIC_SPI 93 IRQ_TYPE_LEVEL_HIGH>;
            status = "okay";
        };
    };
};
